/*
 * Copyright (C) 2012 Texas Instruments Incorporated - http://www.ti.com/
 *
 * This program is free software; you can redistribute it and/or modify
 * it under the terms of the GNU General Public License version 2 as
 * published by the Free Software Foundation.
 */
/dts-v1/;

#include "am33xx.dtsi"
#include "am335x-nbhw-common.dtsi"

/ {
	model = "NetModule NBHW16";
	compatible = "ti,am335x-bone-black", "ti,am335x-bone", "ti,am33xx";

	netmodule-system-info {
		compatible = "netmodule,system-info";
		hardware-base = <16>;
	};
};

&ldo3_reg {
	regulator-min-microvolt = <1800000>;
	regulator-max-microvolt = <1800000>;
	regulator-always-on;
};

