/*
 * Copyright (C) 2012 Texas Instruments Incorporated - http://www.ti.com/
 *
 * This program is free software; you can redistribute it and/or modify
 * it under the terms of the GNU General Public License version 2 as
 * published by the Free Software Foundation.
 */
#include "am335x-nbhw16-prod2.dts"

/ {
	model = "NetModule NBHW16 - NB800-U";
};

&usb0 {
	status = "disabled";
};

&wlcore {
	compatible = "ti,wl1837";
    status = "disabled";
};

